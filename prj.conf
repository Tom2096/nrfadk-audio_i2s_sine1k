## CMakeLists.txt
```
#
# Copyright (c) 2022 Nordic Semiconductor ASA
#
# SPDX-License-Identifier: LicenseRef-Nordic-5-Clause
#

cmake_minimum_required(VERSION 3.20.0)

# Flag which defines whether application is compiled as gateway/dongle or headset
add_compile_definitions(HEADSET=1)
add_compile_definitions(GATEWAY=2)

find_package(Zephyr REQUIRED HINTS $ENV{ZEPHYR_BASE})

project(i2s_sample)

string(TIMESTAMP NRF5340_AUDIO_CORE_APP_COMP_DATE "%a %b %d %H:%M:%S %Y")

# Generate fw_info_app.c
configure_file("${CMAKE_CURRENT_SOURCE_DIR}/src/utils/fw_info_app.c.in"
               "${CMAKE_BINARY_DIR}/fw_info_app.c"
               @ONLY)

# Target sources below are specific to the nRF5340 Audio DK HW
target_sources(app PRIVATE
    ${CMAKE_BINARY_DIR}/fw_info_app.c
    src/main.c
    )

# Include application events and configuration headers
zephyr_library_include_directories(
    include
    src/audio
    src/bluetooth
    src/drivers
    src/modules
    src/utils
    src/utils/macros
)

zephyr_library_include_directories(app PRIVATE
    ${ZEPHYR_NRF_MODULE_DIR}/boards/arm/nrf5340_audio_dk_nrf5340)

# Application sources
add_subdirectory(src/audio)
add_subdirectory(src/drivers)
add_subdirectory(src/modules)
add_subdirectory(src/utils)

## Cirrus Logic
if (CONFIG_HW_CODEC_CIRRUS_LOGIC)
    if (ZEPHYR_CIRRUS_LOGIC_MODULE_DIR)
        add_subdirectory(${ZEPHYR_CIRRUS_LOGIC_MODULE_DIR} cirrus_logic_bin_dir)
    else()
        message(FATAL_ERROR "Cirrus Logic/sdk-mcu-drivers repository not found\n")
    endif()
endif()
```

## prj.conf
```kconfig
#
# Copyright (c) 2022 Nordic Semiconductor ASA
#
# SPDX-License-Identifier: LicenseRef-Nordic-5-Clause
#

# nRF5340 Audio
CONFIG_NRF5340_AUDIO=y

CONFIG_NRF5340_AUDIO_CS47L63_DRIVER=y
CONFIG_WALKIE_TALKIE_DEMO=y
CONFIG_AUDIO_SAMPLE_RATE_16000_HZ=y
CONFIG_AUDIO_SOURCE_USB=n

CONFIG_SAMPLE_RATE_CONVERTER=y
CONFIG_SAMPLE_RATE_CONVERTER_FILTER_SIMPLE=y

# General
CONFIG_DEBUG=y
CONFIG_DEBUG_INFO=y
CONFIG_ASSERT=y
CONFIG_STACK_USAGE=y
CONFIG_THREAD_RUNTIME_STATS=y
CONFIG_STACK_SENTINEL=y
CONFIG_INIT_STACKS=y

# Uart driver
CONFIG_SERIAL=y

# Logging
CONFIG_LOG=y
CONFIG_NEWLIB_LIBC_FLOAT_PRINTF=y
CONFIG_LOG_TAG_MAX_LEN=2
CONFIG_LOG_TAG_DEFAULT="--"
CONFIG_LOG_BACKEND_UART=y
CONFIG_LOG_BUFFER_SIZE=4096

# Use this for debugging thread usage
#CONFIG_LOG_THREAD_ID_PREFIX=y

# Console related defines
CONFIG_CONSOLE=y
CONFIG_RTT_CONSOLE=y
CONFIG_UART_CONSOLE=y

# Shell related defines
CONFIG_SHELL=y
CONFIG_KERNEL_SHELL=y
CONFIG_USE_SEGGER_RTT=y
## Disable logs on RTT
CONFIG_SHELL_RTT_INIT_LOG_LEVEL_NONE=y
CONFIG_SHELL_BACKEND_RTT=y
CONFIG_SHELL_BACKEND_SERIAL=n
CONFIG_SHELL_VT100_COMMANDS=y
CONFIG_SHELL_VT100_COLORS=y
CONFIG_SHELL_STACK_SIZE=4096
CONFIG_SHELL_CMD_BUFF_SIZE=128
## Reduce shell memory usage
CONFIG_SHELL_WILDCARD=n
CONFIG_SHELL_HELP_ON_WRONG_ARGUMENT_COUNT=n
CONFIG_SHELL_STATS=n
CONFIG_SHELL_CMDS=n
CONFIG_SHELL_HISTORY=y

# Turn off default shell commands
CONFIG_I2C_SHELL=n
CONFIG_HWINFO_SHELL=n
CONFIG_CLOCK_CONTROL_NRF_SHELL=n
CONFIG_FLASH_SHELL=n
CONFIG_DEVICE_SHELL=n

# Suppress LOG_ERR messages from sd_check_card_type. Because SPI_SDHC has no card presence method,
# assume card is in slot. Thus error message is always shown if card is not inserted
CONFIG_SD_LOG_LEVEL_OFF=y

# Suppress LOG_INF messages from hci_core
CONFIG_BT_HCI_CORE_LOG_LEVEL_WRN=y
```

## src/main.c
```c
/*
	Author: Tom He
	Email: sy4he@uwaterloo.ca
*/

#include <zephyr/kernel.h>
#include <nrfx_clock.h>
#include <audio_i2s.h>
#include <audio_i2s_macros.h>
#include <zephyr/sys/ring_buffer.h>
#include <pcm_stream_channel_modifier.h>
#include <macros_common.h>
#include <hw_codec.h>
#include <tone.h>

#include <zephyr/logging/log.h>
LOG_MODULE_REGISTER(main, CONFIG_MAIN_LOG_LEVEL);

#define CONFIG_LOGGING

static uint8_t *tx_buf;
static uint32_t *rx_buf;

static uint8_t sine_1000hz_16bits_mono[BLK_MONO_SIZE_OCTETS] = { 0 };
static uint8_t sine_1000hz_16bits_stereo[BLK_STEREO_SIZE_OCTETS] = { 0 };

K_SEM_DEFINE(sem_ringbuf_space_available, 1, 1);
K_MUTEX_DEFINE(mtx_ringbuf);
RING_BUF_DECLARE(ringbuf_audio_data, RING_BUF_SIZE);

/* Alternate-buffers used when there is no active audio stream.
 * Used interchangeably by I2S.
 */
static struct {
	uint8_t __aligned(WB_UP(1)) buf_0[BLK_MONO_SIZE_OCTETS];
	uint8_t __aligned(WB_UP(1)) buf_1[BLK_MONO_SIZE_OCTETS];
	bool buf_0_in_use;
	bool buf_1_in_use;
} alt;

/**
 * @brief	Get first available alternative-buffer.
 *
 * @param	p_buffer	Double pointer to populate with buffer.
 *
 * @retval	0 if success.
 * @retval	-ENOMEM No available buffers.
 */
static int alt_buffer_get(void **p_buffer)
{
	if (!alt.buf_0_in_use) {
		alt.buf_0_in_use = true;
		*p_buffer = alt.buf_0;
	} else if (!alt.buf_1_in_use) {
		alt.buf_1_in_use = true;
		*p_buffer = alt.buf_1;
	} else {
		return -ENOMEM;
	}

	return 0;
}

/**
 * @brief	Frees both alternative buffers.
 */
static void alt_buffer_free_both(void)
{
	alt.buf_0_in_use = false;
	alt.buf_1_in_use = false;
}

static int ringbuf_write()
{
	int ret;
	uint8_t *buf;
	size_t write_size = RING_BUF_FILL_SIZE;

	/* The ringbuffer is read every 10 ms by audio datapath when SD card playback is enabled.
	 * Timeout value should therefore not be less than 10 ms
	 */
	ret = k_sem_take(&sem_ringbuf_space_available, K_MSEC(20));
	if (ret) {
		LOG_ERR("Sem take err: %d. Skipping frame", ret);
		return ret;
	}

	write_size = ring_buf_put_claim(&ringbuf_audio_data, &buf, write_size);
	memcpy(buf, sine_1000hz_16bits_stereo, write_size);
	ret = ring_buf_put_finish(&ringbuf_audio_data, write_size);
	if (ret) {
		LOG_ERR("Ring buf put finish err: %d", ret);
		return ret;
	}

	return 0;
}

static void ringbuf_read()
{
	size_t read_size = BLK_MONO_SIZE_OCTETS;

	read_size = ring_buf_get_claim(&ringbuf_audio_data, &tx_buf, read_size);
	if (read_size != BLK_MONO_SIZE_OCTETS) {
		LOG_WRN("Read size (%d) not equal requested size (%d)", read_size, BLK_MONO_SIZE_OCTETS);
	}

	/*** Data exchange ***/
	audio_i2s_set_next_buf(tx_buf, rx_buf);

	ring_buf_get_finish(&ringbuf_audio_data, read_size);

	if (ring_buf_space_get(&ringbuf_audio_data) >= RING_BUF_FILL_SIZE) {
		k_sem_give(&sem_ringbuf_space_available);
	}
}

static int hfclock_config_and_start(void)
{
	int ret;

	/* Use this to turn on 128 MHz clock for cpu_app */
	ret = nrfx_clock_divider_set(NRF_CLOCK_DOMAIN_HFCLK, NRF_CLOCK_HFCLK_DIV_1);

	ret -= NRFX_ERROR_BASE_NUM;
	if (ret) {
		return ret;
	}

	nrfx_clock_hfclk_start();
	while (!nrfx_clock_hfclk_is_running()) {
	}

	return 0;
}

int main(void) 
{
    int ret;

#ifdef CONFIG_LOGGING
    printk("\nLogging I2S Info ...\n");
    printk("\nCONFIG_I2S_LRCK_FREQ_HZ:     %d\n", CONFIG_I2S_LRCK_FREQ_HZ);
    printk("\nCONFIG_I2S_CH_NUM:           %d\n", CONFIG_I2S_CH_NUM);
    printk("\nCONFIG_AUDIO_BIT_DEPTH_BITS: %d\n", CONFIG_AUDIO_BIT_DEPTH_BITS);
#endif

	ret = hfclock_config_and_start();
	ERR_CHK(ret);

	audio_i2s_blk_comp_cb_register(ringbuf_read);
	audio_i2s_init();

	ret = hw_codec_init();
	if (ret) {
		LOG_ERR("Failed to initialize HW codec: %d", ret);
		return ret;
	}
	hw_codec_volume_set(100);

	printk("\nStarting I2S!\n");

	/* Starting I2S */

	/********** I2S TX **********/
	ret = alt_buffer_get((void **)&tx_buf);
	ERR_CHK(ret);

	/********** I2S RX **********/
	ret = alt_buffer_get((void **)&rx_buf);
	ERR_CHK(ret);

	/*
		BLK_MONO_SIZE_OCTETS = 32, therefore if every sample is 16bits, then 
		one buffer will hold exactly 
		
			32 / 2 = 16 samples
		
		Since I2S expects interleaving left/right audio data, this means we can fit 
		8 unique samples in a single buffer.

		If we want to hear 1000Hz sine wave, we need to play two alternating buffers,
		each holding 8 unique samples representing half a period.  
	*/
	size_t tone_size;
	ret = tone_gen((int16_t *)sine_1000hz_16bits_mono, &tone_size, 1000, CONFIG_I2S_LRCK_FREQ_HZ, 1.0);
	if (ret || tone_size != BLK_MONO_SIZE_OCTETS) {
		LOG_ERR("Failed to generate test tone");
		return ret;
	}
	
	ret = pscm_copy_pad(sine_1000hz_16bits_mono, BLK_MONO_SIZE_OCTETS, 
							CONFIG_AUDIO_BIT_DEPTH_BITS,
							sine_1000hz_16bits_stereo,
							&tone_size);
	if (ret || tone_size != BLK_STEREO_SIZE_OCTETS) {
		LOG_ERR("Failed to generate dual tone");
	}

	memset(tx_buf, 0, BLK_MONO_SIZE_OCTETS);
	ringbuf_write();

	ret = hw_codec_default_conf_enable();
	ERR_CHK(ret);
	audio_i2s_start(tx_buf, rx_buf);
	// Need to run this manually once to trigger the callback
	audio_i2s_set_next_buf(tx_buf, rx_buf);
	
	int64_t start_time = k_uptime_get();
	while (true) {

		int64_t current_time = k_uptime_get();
		int64_t elapsed_time_ms = current_time - start_time;
		
        if (elapsed_time_ms >= 5000) { // Check if 5000ms has passed
            break; // Exit the loop after 5 seconds
        }

		ringbuf_write();
	}

	ret = hw_codec_soft_reset();
	ERR_CHK(ret);
	audio_i2s_stop();
	
	alt_buffer_free_both();

	printk("\nI2S Stopped!\n");

    return 0;
}
```

## include/audio_i2s_macros.h
```c
#include <audio_i2s.h>

#define BLK_PERIOD_US 1000

/* Number of audio blocks given a duration */
#define NUM_BLKS(d) ((d) / BLK_PERIOD_US)
/* Single audio block size in number of samples (stereo) */
/* clang-format off */
#define BLK_SIZE_SAMPLES(r) (((r)*BLK_PERIOD_US) / 1000000)

#define NUM_BLKS_IN_FRAME      NUM_BLKS(CONFIG_AUDIO_FRAME_DURATION_US)
#define BLK_MONO_NUM_SAMPS     BLK_SIZE_SAMPLES(CONFIG_AUDIO_SAMPLE_RATE_HZ)

/* Number of octets in a single audio block */
#define BLK_MONO_SIZE_OCTETS   (BLK_MONO_NUM_SAMPS * CONFIG_AUDIO_BIT_DEPTH_OCTETS)
#define BLK_STEREO_SIZE_OCTETS (BLK_MONO_SIZE_OCTETS * 2)

/* Size of ring buffer in bytes */
#define RING_BUF_SIZE 960

/* How many bytes we can fill at a time */
#define RING_BUF_FILL_SIZE 64
```
